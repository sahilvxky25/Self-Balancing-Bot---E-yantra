#include <Wire.h>
#include <MPU6050_light.h>
#include <SoftwareSerial.h>
#include <Servo.h>

/* =====================================================
   ================= GLOBAL OBJECTS ====================
   ===================================================== */

/*
Variable Name: mpu
Description : MPU6050 IMU object used for angle estimation
Range       : Internal to library
*/
MPU6050 mpu(Wire);
unsigned int step_count = 0;
unsigned int step_countB = 0;
bool move1 = false;
bool move2 = false; 
/* =====================================================
   ================= MOTOR PINS ========================
   ===================================================== */

/*
Variable Name: motor1A, motor1B
Description : Direction control pins for left motor
Range       : Digital HIGH / LOW
*/
int motor1A = A3, motor1B = A2;

/*
Variable Name: enable1
Description : PWM pin for left motor speed control
Range       : 0 – 255
*/
int enable1 = 6;

/*
Variable Name: motor2A, motor2B
Description : Direction control pins for right motor
Range       : Digital HIGH / LOW
*/
int motor2A = 9, motor2B = 4;

/*
Variable Name: enable2
Description : PWM pin for right motor speed control
Range       : 0 – 255
*/
int enable2 = 5;

/*
Variable Name: buzz
Description : Buzzer pin for audio feedback
Range       : Digital output
*/
const int buzz = A1;

/* =====================================================
   ================= PID GAINS =========================
   ===================================================== */

/*
Inner Loop PID (Angle Control)
Purpose: Maintains upright balance
*/
double Kp = 35;     // Proportional gain
double Ki = 270;    // Integral gain
double Kd = 0.2;   // Derivative gain

/*
Outer Loop PID (Velocity Control)
Purpose: Converts velocity error into target angle
*/
//double Kp_Vel = 0.00011;
double Kp_Vel = 0.00001;
double ki_Vel = 0;
double kd_Vel = 0.00090;
double alpha1 = 0.9;
double alpha2 = 0.7;
/* =====================================================
   ================= SYSTEM PARAMETERS =================
   ===================================================== */

/*
Variable Name: frictionOffset
Description : Compensates static friction in motors
Range       : Typically 10 – 30
*/
int frictionOffset = 4;

/*
Variable Name: AngleOffset
Description : IMU mounting offset correction
Range       : Small value in degrees
*/
double AngleOffset = 0.46;

/* =====================================================
   ================= TARGET VARIABLES ==================
   ===================================================== */

/*
Variable Name: targetVelocity
Description : Desired forward/backward velocity
Range       : Encoder counts per loop
*/
double targetVelocity = 0;

/*
Variable Name: targetYaw_RATE
Description : Desired turning rate
Range       : ± few PWM units
*/
double targetYaw_RATE = 0;

/* =====================================================
   ================= MPU OFFSETS =======================
   ===================================================== */

/*
Gyroscope and accelerometer calibration offsets
Obtained experimentally
*/
const float GYRO_X_OFFSET = -0.0153;
const float GYRO_Y_OFFSET = -0.0153;
const float GYRO_Z_OFFSET = -0.0153;
const float ACC_X_OFFSET  = 0.0;
const float ACC_Y_OFFSET  = 0.0;
const float ACC_Z_OFFSET  = -1.0;

/* =====================================================
   ================= STATE VARIABLES ===================
   ===================================================== */

/*
Variable Name: currentAngle
Description : Current robot tilt angle
Range       : Degrees
*/
double currentAngle = 0;

/*
Variable Name: currentVelocity
Description : Measured velocity from encoders
Range       : Encoder counts
*/
double currentVelocity = 0;

/* -------- Angle PID States -------- */
double error_Ang = 0;
double prevError_Ang = 0;
double integral_Ang = 0;
double filteredD_Ang = 0;
double filteredD_Pos = 0;
/*
Variable Name: targetAngle_cmd
Description : Angle command generated by velocity loop
Range       : Small angle in degrees
*/
volatile double targetAngle_cmd = 0.0;

/* -------- Velocity PID States -------- */
double error_Vel = 0;
double prevError_Vel = 0;
double integral_Vel = 0;
/* =====================================================
   ================= YAW PID (RATE LOOP) ===============
   ===================================================== */

double Kp_Yaw = 3.5;
double Ki_Yaw = 0.0;
double Kd_Yaw = 0.05;

double error_Yaw = 0;
double prevError_Yaw = 0;
double integral_Yaw = 0;
double filteredD_Yaw = 0;

double yawRateMeasured = 0;   // deg/sec
double yawCommand = 0;        // correction added to motors

double alphaYaw = 1;


/* =====================================================
   ================= CONTROL LIMITS ====================
   ===================================================== */

const double VEL_STEP   = 144;
const double YAW_STEP_RATE = 5;

/* =====================================================
   ================= TIME VARIABLES ====================
   ===================================================== */

/*
Variable Name: dt
Description : Loop time difference
Range       : Seconds
*/
unsigned long currentTime, previousTime = 0;
double dt;
unsigned long currentTime1,previousTime1 = 0;
double dt1;
/* =====================================================
   ================= BLUETOOTH =========================
   ===================================================== */
#define BT_RX 0
#define BT_TX 1
SoftwareSerial BT(BT_RX, BT_TX);

/* =====================================================
   ================= ENCODERS ==========================
   ===================================================== */
#define encodPinAR 2
#define encodPinBR 3
#define encodPinAL 7
#define encodPinBL 8

volatile long wheel_pulse_count_left = 0;
volatile long wheel_pulse_count_right = 0;

/* =====================================================
   ================= SERVOS ============================
   ===================================================== */
#define SERVO1_PIN 10
#define SERVO2_PIN 11

Servo servo1, servo2;

double SERVO_STEP_RATE1 = 90;
double SERVO_STEP_RATE2 = 90;

const int SERVO_MIN = 0;
const int SERVO_MAX = 180;

/* =====================================================
   ====================== SETUP ========================
   ===================================================== */

/*
Function Name : setup
Input         : None
Output        : None
Logic         :
  - Initializes IMU, motors, encoders, servos
  - Applies calibration offsets
Example Call  : Automatically called by Arduino
*/
void setup() {
  Serial.begin(9600);
  Wire.begin();

  mpu.begin();
  mpu.setGyroOffsets(GYRO_X_OFFSET, GYRO_Y_OFFSET, GYRO_Z_OFFSET);
  mpu.setAccOffsets(ACC_X_OFFSET, ACC_Y_OFFSET, ACC_Z_OFFSET);

  pinMode(motor1A, OUTPUT);
  pinMode(motor1B, OUTPUT);
  pinMode(enable1, OUTPUT);
  pinMode(motor2A, OUTPUT);
  pinMode(motor2B, OUTPUT);
  pinMode(enable2, OUTPUT);

  pinMode(encodPinAR, INPUT_PULLUP);
  pinMode(encodPinBR, INPUT_PULLUP);
  attachInterrupt(digitalPinToInterrupt(encodPinAR), ISR_rightA, CHANGE);

  servo1.attach(SERVO1_PIN);
  servo2.attach(SERVO2_PIN);
  servo1.write(SERVO_STEP_RATE1);
  servo2.write(SERVO_STEP_RATE2);
}

/* =====================================================
   ================= BLUETOOTH HANDLER =================
   ===================================================== */

/*
Function Name : handleBluetoothInput
Input         : None (reads Serial buffer)
Output        : None
Logic         :
  - Decodes command characters
  - Updates velocity, yaw, and servo positions
Example Call  : handleBluetoothInput();
*/
void handleBluetoothInput() {
  while (Serial.available()) {
    char cmd = Serial.read();
    switch (cmd) {
      case '+': AngleOffset += 0.02; break;
      case '-': AngleOffset -= 0.02; break;
      case 'X': 
      Serial.print("Angle Offset :"); 
      Serial.println(AngleOffset); break;
      case 'F':
        targetVelocity+=VEL_STEP;
        move1 = true;
        break;
      case 'B':
        targetVelocity-=VEL_STEP;
        move2 = true;
        break;
      case 'R': targetYaw_RATE =  YAW_STEP_RATE; break;
      case 'L': targetYaw_RATE = -YAW_STEP_RATE; break;
      case 'S': targetYaw_RATE = 0; break;
      case 'U': SERVO_STEP_RATE1 = constrain(SERVO_STEP_RATE1 + 5, SERVO_MIN, SERVO_MAX); servo1.write(SERVO_STEP_RATE1); break;
      case 'D': SERVO_STEP_RATE1 = constrain(SERVO_STEP_RATE1 - 5, SERVO_MIN, SERVO_MAX); servo1.write(SERVO_STEP_RATE1); break;
      case 'Q': SERVO_STEP_RATE2 = constrain(SERVO_STEP_RATE2 + 15, SERVO_MIN, SERVO_MAX); servo2.write(SERVO_STEP_RATE2); break;
      case 'E': SERVO_STEP_RATE2 = constrain(SERVO_STEP_RATE2 - 15, SERVO_MIN, SERVO_MAX); servo2.write(SERVO_STEP_RATE2); break;
      case 'M': tone(buzz, 2000); delay(500); noTone(buzz); break;
    }
  }
}

/* =====================================================
   ================= MAIN LOOP =========================
   ===================================================== */

/*
Function Name : loop
Input         : None
Output        : None
Logic         :
  - Runs angle loop at higher frequency
  - Runs velocity loop at lower frequency
*/
unsigned int counter = 0;

void loop() {
  
  handleBluetoothInput();

  if (counter < 7) {
    counter++;
    runAngleLoop();
  }

  if (counter == 7) {
    counter = 0;
    runPositionLoop();
  }
  if(step_count==36){
    step_count=0;
    move1=false;
  }
  if(step_countB==36){
    step_countB=0;
    move2=false;
  }
}

/* =====================================================
   ============ OUTER LOOP : VELOCITY PID ===============
   ===================================================== */

/*
Function Name : runPositionLoop
Input         : None
Output        : Updates targetAngle_cmd
Logic         :
  - Computes velocity from encoders
  - PID converts velocity error to angle command
Example Call  : runPositionLoop();
*/
void runPositionLoop() {
  currentTime = micros();
  dt = (currentTime - previousTime)*(1e-6);
  previousTime = currentTime;
  noInterrupts();
  if(move1){
    targetVelocity+=4;
    step_count++;
  }
  if(move2){
    targetVelocity-=4;
    step_countB++;
  }
  long left  = wheel_pulse_count_left;
  long right = wheel_pulse_count_right;
  interrupts();

  currentVelocity = (left - right);
  error_Vel = targetVelocity - currentVelocity;

  integral_Vel += error_Vel * dt;
  //integral_Vel = constrain(integral_Vel, -500, 500);

  double dVel = (error_Vel - prevError_Vel) / dt;
  filteredD_Pos = ((1-alpha1)*filteredD_Pos)+(alpha1*dVel);
  prevError_Vel = error_Vel;

  targetAngle_cmd =
    (Kp_Vel * error_Vel) +
    (ki_Vel * integral_Vel) +
    (kd_Vel * filteredD_Pos);
  //targetAngle_cmd = constrain(targetAngle_cmd,-8,8);
}
/* =====================================================
   ============== INNER LOOP : ANGLE PID ================
   ===================================================== */

/*
Function Name : runAngleLoop
Input         : None

Output        : Motor PWM signals
Logic         :
  - Stabilizes robot angle
  - Applies friction compensation and yaw mixing
Example Call  : runAngleLoop();
*/
void runAngleLoop() {
  currentTime1 = micros();
  dt1 = (currentTime1 - previousTime1) * (1e-6);
  previousTime1 = currentTime1;

  mpu.update();

  currentAngle = mpu.getAngleY() - AngleOffset;

  // ---------------- ANGLE PID ----------------
  error_Ang = targetAngle_cmd - currentAngle;

  integral_Ang += error_Ang * dt1;
  integral_Ang = constrain(integral_Ang, -100, 100);

  double dAng = (error_Ang - prevError_Ang) / dt1;
  filteredD_Ang = ((1 - alpha2) * filteredD_Ang) + (alpha2 * dAng);
  prevError_Ang = error_Ang;

  double motorCommand =
    (Kp * error_Ang) +
    (Ki * integral_Ang) +
    (Kd * filteredD_Ang);

  if (motorCommand > 0) motorCommand += frictionOffset;
  else if (motorCommand < 0) motorCommand -= frictionOffset;

  // ---------------- YAW RATE MEASUREMENT ----------------
  yawRateMeasured = mpu.getAngleZ();  // deg

  // ---------------- YAW PID ----------------
  error_Yaw = targetYaw_RATE - yawRateMeasured;

  integral_Yaw += error_Yaw * dt1;

  double dYaw = (error_Yaw - prevError_Yaw) / dt1;
  filteredD_Yaw = ((1 - alphaYaw) * filteredD_Yaw) + (alphaYaw * dYaw);
  prevError_Yaw = error_Yaw;

  yawCommand =
      (Kp_Yaw * error_Yaw) +
      (Ki_Yaw * integral_Yaw) +
      (Kd_Yaw * filteredD_Yaw);

  yawCommand = constrain(yawCommand, -80, 80);

  // ---------------- MIXING ----------------
  double leftCmd  = motorCommand - yawCommand;
  double rightCmd = motorCommand + yawCommand;

  controlMotors(motorCommand,
                constrain(abs(leftCmd), 0, 255),
                constrain(abs(rightCmd), 0, 255));
}


/* =====================================================
   ================= MOTOR CONTROL =====================
   ===================================================== */

/*
Function Name : controlMotors
Input         :
  - cmd        : Sign determines direction
  - leftSpeed  : PWM for left motor
  - rightSpeed : PWM for right motor
Output        : None
Logic         :
  - Sets motor direction and speed
*/
void controlMotors(double cmd, int leftSpeed, int rightSpeed) {
  if (cmd > 0) {
    digitalWrite(motor1A, HIGH); digitalWrite(motor1B, LOW);
    digitalWrite(motor2A, HIGH); digitalWrite(motor2B, LOW);
  } else {
    digitalWrite(motor1A, LOW); digitalWrite(motor1B, HIGH);
    digitalWrite(motor2A, LOW); digitalWrite(motor2B, HIGH);
  }
  analogWrite(enable1, leftSpeed);
  analogWrite(enable2, rightSpeed);
}

/* =====================================================
   ================= ENCODER ISR =======================
   ===================================================== */

/*
Function Name : ISR_rightA
Input         : Hardware interrupt
Output        : Updates wheel_pulse_count_right
Logic         :
  - Determines direction using quadrature logic
*/
void ISR_rightA() {
  if (digitalRead(encodPinAR) == digitalRead(encodPinBR))
    wheel_pulse_count_right++;
  else
    wheel_pulse_count_right--;
}